## Documentation/devicetree/bindings/input/mxs-pswitch.txt
```
* Freescale i.MX23/i.MX28 power switch device tree bindings

The Freescale MXS SoC has a pswitch pin which has several power related
functions determined by a product's hardware and software design.

The pswitch input driver allow for the user space handling of power events.

Required properties:
- compatible:
  - "fsl,imx23-pswitch" for i.MX23
  - "fsl,imx28-pswitch" for i.MX28
- interrupts: The pswitch interrupt number.
- linux,code: The linux key code the event maps to.

Example for i.MX28:

	power: power@80044000 {
		compatible = "fsl,imx28-power", "syscon";
		reg = <0x80044000 0x2000>;
		#address-cells = <1>;
		#size-cells = <0>;

		pswitch: pswitch@5 {
			compatible = "fsl,imx28-pswitch";
			reg = <0x5>;
			linux,code = <116>;
			interrupts = <6>;
		};
	};
```

## Documentation/devicetree/bindings/power/mxs_power.txt
```
Power subsystem for Freescale i.MX23/i.MX28

Required properties:
- compatible: Should be "fsl,<soc>-power". The supported SoCs include
  imx23 and imx28.
- reg: Address and length of the register set for the power subsystem.

Optional properties;
- interrupts: Interrupts used by the power subsystem

Example for i.MX28:

	power: power@80044000 {
		compatible = "fsl,imx28-power", "syscon";
		reg = <0x80044000 0x2000>;
		interrupts = <6>;
	}
```

## Documentation/devicetree/bindings/regulator/mxs-regulator.txt
```
Regulators on Freescale i.MX23/i.MX28

i.MX23 linear regulator daisy chain:

+------------+     VDD5V  +---------+  VDDIO
| DC-DC      |   +--------> LINREG  +--------->+
|            |            | VDDIO   |          |
|            |            +---------+          |
| DCDC_VDDIO +->-+-----------------------------+
|            |   |
|            |   | VDDIO  +---------+  VDDMEM
|            |   +--------> LINREG  +--------->
|            |   |        | VDDMEM  |
|            |   |        +---------+
|            |   | VDDIO  +---------+  VDDA
|            |   +--------> LINREG  +--------->+
|            |            | VDDA    |          |
|            |            +---------+          |
| DCDC_VDDA  +->-+-----------------------------+
|            |   | VDDA   +---------+  VDDD
|            |   +--------> LINREG  +--------->+
|            |            | VDDD    |          |
|            |            +---------+          |
| DCDC_VDDD  +->-------------------------------+
+------------+                                 |
                                               v

i.MX28 linear regulator daisy chain:

+------------+     VDD5V  +---------+  VDDIO
| DC-DC      |   +--------> LINREG  +--------->+
|            |            | VDDIO   |          |
|            |            +---------+          |
| DCDC_VDDIO +->-+-----------------------------+
|            |   |
|            |   | VDDIO  +---------+  VDDA
|            |   +--------> LINREG  +--------->+
|            |            | VDDA    |          |
|            |            +---------+          |
| DCDC_VDDA  +->-+-----------------------------+
|            |   |
|            |   | VDDA   +---------+  VDDMEM
|            |   +--------> LINREG  +--------->
|            |   |        | VDDMEM  |
|            |   |        +---------+
|            |   | VDDA   +---------+  VDDD
|            |   +--------> LINREG  +--------->+
|            |            | VDDD    |          |
|            |            +---------+          |
| DCDC_VDDD  +->-------------------------------+
+------------+                                 |
                                               v

Required properties:
- compatible (imx23 and imx28 supported):
  - "fsl,<soc>-dcdc" for DC-DC converter
  - "fsl,<soc>-vddd" for VDDD linear regulator
  - "fsl,<soc>-vdda" for VDDA linear regulator
  - "fsl,<soc>-vddio" for VDDIO linear regulator
  - "fsl,<soc>-vddmem" for VDDMEM linear regulator

Optional properties:
- switching-frequency: switching frequency for the DC-DC converter in Hz.
  Possible values are <1200000>, <1250000> or <1500000> (default).

Any regulator property defined as part of the core regulator
binding, defined in regulator.txt, can also be used.

Example for i.MX28:

	power: power@80044000 {
		compatible = "fsl,imx28-power", "syscon";
		reg = <0x80044000 0x2000>;
		#address-cells = <1>;
		#size-cells = <0>;
		interrupts = <6>;

		dcdc: regulator@1 {
			compatible = "fsl,imx28-dcdc";
			reg = <0x1>;
			regulator-name = "dcdc";
			regulator-boot-on;
			regulator-always-on;
			switching-frequency = <1250000>;
		};

		reg_vddd: regulator@2 {
			compatible = "fsl,imx28-vddd";
			reg = <0x2>;
			regulator-name = "vddd";
			regulator-min-microvolt = <1350000>;
			regulator-max-microvolt = <1550000>;
		};
	};
```

## arch/arc/plat-eznps/Kconfig
```kconfig
#
# For a description of the syntax of this configuration file,
# see Documentation/kbuild/kconfig-language.txt.
#

menuconfig ARC_PLAT_EZNPS
	bool "\"EZchip\" ARC dev platform"
	select CPU_BIG_ENDIAN
	select CLKSRC_NPS
	select EZNPS_GIC
	select EZCHIP_NPS_MANAGEMENT_ENET if ETHERNET
	help
	  Support for EZchip development platforms,
	  based on ARC700 cores.
	  We handle few flavors:
	    - Hardware Emulator AKA HE which is FPGA based chassis
	    - Simulator based on MetaWare nSIM
	    - NPS400 chip based on ASIC

config EZNPS_MTM_EXT
	bool "ARC-EZchip MTM Extensions"
	select CPUMASK_OFFSTACK
	depends on ARC_PLAT_EZNPS && SMP
	default y
	help
	  Here we add new hierarchy for CPUs topology.
	  We got:
		Core
		Thread
	  At the new thread level each CPU represent one HW thread.
	  At highest hierarchy each core contain 16 threads,
	  any of them seem like CPU from Linux point of view.
	  All threads within same core share the execution unit of the
	  core and HW scheduler round robin between them.

config EZNPS_MEM_ERROR
       bool "ARC-EZchip Memory error as an exception"
       depends on ARC_PLAT_EZNPS
       default n
       help
	  Enable this for NPS Silicon (not simulator)
	  On the real chip of the NPS, user memory errors are handled
	  as a machine check exception, whereas on simulator platform
	  for NPS, it handled as an interrupt level 2 (like legacy arc
	  real chip architecture).This configuration will cause the kernel
	  to handle memory error as a machine check exception.
```

## arch/arc/plat-hsdk/Kconfig
```kconfig
#
# Copyright (C) 2017 Synopsys, Inc. (www.synopsys.com)
#
# This program is free software; you can redistribute it and/or modify
# it under the terms of the GNU General Public License version 2 as
# published by the Free Software Foundation.
#

menuconfig ARC_PLAT_HSDK
	bool "ARC HS Development Kit board"
	help
	  Support for ARC HS Development Kit board
```
